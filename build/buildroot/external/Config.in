## build/buildroot/external/Config.in
```kconfig
source "$BR2_EXTERNAL_NODEOS_PATH/package/kubelet/Config.in"
source "$BR2_EXTERNAL_NODEOS_PATH/package/crictl/Config.in"
```

## build/buildroot/external/package/containerd-bin/Config.in
```kconfig
config BR2_PACKAGE_CONTAINERD_BIN
	bool "containerd (static binary)"
	depends on BR2_x86_64
	help
	  containerd container runtime, installed from the official static
	  linux/amd64 release (bundles containerd, containerd-shim-runc-v2, ctr).
	  Pinned independently of Buildroot's in-tree containerd so the NodeOS k8s
	  profile can track the desired version (2.3.x). Disable BR2_PACKAGE_CONTAINERD
	  (the in-tree 2.0.x package) when using this.

	  https://containerd.io
```

## build/buildroot/external/package/crictl/Config.in
```kconfig
config BR2_PACKAGE_CRICTL
	bool "crictl"
	depends on BR2_x86_64
	help
	  crictl, the CRI command-line client (cri-tools). Installs the official
	  static linux/amd64 release archive from the kubernetes-sigs/cri-tools
	  releases. Used to inspect/exercise the containerd CRI on a NodeOS k8s node.

	  https://github.com/kubernetes-sigs/cri-tools
```

## build/buildroot/external/package/kubelet/Config.in
```kconfig
config BR2_PACKAGE_KUBELET
	bool "kubelet"
	depends on BR2_x86_64
	help
	  kubelet, the Kubernetes node agent. Installs the official static
	  linux/amd64 release binary from dl.k8s.io (kubelet is not packaged in
	  Buildroot). Used by the NodeOS k8s workload profile.

	  https://kubernetes.io/docs/reference/command-line-tools-reference/kubelet/
```

## build/buildroot/qemu-aarch64.defconfig
```kconfig
BR2_aarch64=y
BR2_TOOLCHAIN_BUILDROOT_MUSL=y
BR2_INIT_NONE=y
BR2_SYSTEM_BIN_SH_NONE=y
BR2_PACKAGE_BUSYBOX=n
BR2_TARGET_ROOTFS_INITRAMFS=y
BR2_ROOTFS_OVERLAY="build/buildroot/overlay"
BR2_ROOTFS_POST_BUILD_SCRIPT="build/buildroot/post-build.sh"
```
